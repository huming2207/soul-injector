## main/Kconfig.projbuild
```kconfig
menu "Soul Injector Configuration"

    config SI_DEVICE_MODEL
        string "Device model"
        default "Soul Injector Basic"
        help
            Device model name

    config SI_DEVICE_BUILD
        string "Device version"
        default "1.0.0"
        help
            Device version number

    config SI_DISP_ENABLE
        bool "Enable display support"
        default y
        help
            Enable LCD display

    choice SI_DISP_PANEL_PORT
        prompt "Display panel port"
        default SI_DISP_SPI

        config SI_DISP_SPI
            bool
            prompt "SPI"

        config SI_DISP_I80
            bool
            prompt "I80"
    endchoice

    choice SI_DISP_PANEL_MODEL
        prompt "Display panel model"
        default SI_DISP_PANEL_LHS154KC

        config SI_DISP_PANEL_LHS154KC
            bool
            depends on SI_DISP_SPI
            prompt "ZJY LHS154KC 1.54 inch, HannStar LCD + ST7789v3"

        config SI_DISP_PANEL_NFP190B
            bool
            depends on SI_DISP_I80
            prompt "ZJY NFP190B 1.9 inch, ST7789v3, parallel port"

        config SI_DISP_PANEL_NFP114H
            bool
            depends on SI_DISP_SPI
            prompt "ZJY NFP114H 1.14 inch ST7789, SPI"

    endchoice

    config SI_DISP_PANEL_NFP114H_ALT_INIT_CFG
        bool "Display: NFP114H: use alternative init settings"
        depends on SI_DISP_PANEL_NFP114H
        default n
        help
            Alternative VCOM and Gamma settings for NFP114H LCD

    config SI_DISP_PANEL_IO_SCLK
        int "Display SPI CLK pin"
        depends on SI_DISP_ENABLE
        default 6
        help
             LCD panel's SPI SCLK pin

    config SI_DISP_PANEL_IO_MOSI
        int "Display SPI data output (MOSI) pin"
        depends on SI_DISP_ENABLE
        depends on SI_DISP_SPI
        default 5
        help
             LCD panel's SPI MOSI pin

    config SI_DISP_PANEL_IO_RST
        int "Display reset pin"
        depends on SI_DISP_ENABLE
        default 4
        help
             LCD panel's reset pin

    config SI_DISP_PANEL_IO_DC
        int "Display D/C pin"
        depends on SI_DISP_ENABLE
        default 15
        help
             LCD panel's Data/Command control pin

    config SI_DISP_PANEL_IO_CS
        int "Display CS pin"
        depends on SI_DISP_ENABLE
        default 7
        help
             LCD panel's SPI chip select pin

    config SI_DISP_PANEL_IO_D0
        int "Display I80 DATA0"
        depends on SI_DISP_ENABLE
        depends on SI_DISP_I80
        default 39
        help
             LCD panel's I80 data pin

    config SI_DISP_PANEL_IO_D1
        int "Display I80 DATA1"
        depends on SI_DISP_ENABLE
        depends on SI_DISP_I80
        default 40
        help
             LCD panel's I80 data pin

    config SI_DISP_PANEL_IO_D2
        int "Display I80 DATA2"
        depends on SI_DISP_ENABLE
        depends on SI_DISP_I80
        default 41
        help
             LCD panel's I80 data pin

    config SI_DISP_PANEL_IO_D3
        int "Display I80 DATA3"
        depends on SI_DISP_ENABLE
        depends on SI_DISP_I80
        default 42
        help
             LCD panel's I80 data pin

    config SI_DISP_PANEL_IO_D4
        int "Display I80 DATA4"
        depends on SI_DISP_ENABLE
        depends on SI_DISP_I80
        default 45
        help
             LCD panel's I80 data pin

    config SI_DISP_PANEL_IO_D5
        int "Display I80 DATA5"
        depends on SI_DISP_ENABLE
        depends on SI_DISP_I80
        default 46
        help
             LCD panel's I80 data pin

    config SI_DISP_PANEL_IO_D6
        int "Display I80 DATA6"
        depends on SI_DISP_ENABLE
        depends on SI_DISP_I80
        default 47
        help
             LCD panel's I80 data pin

    config SI_DISP_PANEL_IO_D7
       int "Display I80 DATA7"
       depends on SI_DISP_ENABLE
        depends on SI_DISP_I80
       default 48
       help
            LCD panel's I80 data pin

    config SI_DISP_PANEL_IO_RD
        int "Display I80 RD"
        depends on SI_DISP_ENABLE
        depends on SI_DISP_I80
        default 9
        help
            LCD panel's I80 RD pin

    config SI_DISP_PANEL_BKL
        int "Display backlight control"
        depends on SI_DISP_ENABLE
        default 38
        help
            LCD panel's backlight control

    config SI_DISP_PANEL_PWR
        int "Display power control"
        depends on SI_DISP_ENABLE
        default 15
        help
            LCD panel's power control

    config SI_DISP_PANEL_BUFFER_SIZE
        int "Display buffer size"
        depends on SI_DISP_ENABLE
        default 9600
        help
             Render/SPI DMA buffer size

    config SI_DISP_SLOW_CLK
        bool "Slow down LCD display's SPI Clock"
        default n
        help
            Slow down the SPI clock for debugging

    config SI_LED_SIGNAL_PIN
        int "LED indicator pin"
        default 10
        help
            RGB LED pin

    choice SI_LED_MODEL
        prompt "LED indicator model"
        default SI_LED_WS2812B

        config SI_LED_WS2812B
            bool
            prompt "WS2812B-B"

        config SI_LED_SK6812RGB
            bool
            prompt "SK6812 (RGB, no white)"
    endchoice

    config SI_MQ_RECV_TIMEOUT
        int "MQ client: Receive timeout in millisecond"
        default 3000
        help
            General receive timeout in millisecond, used in MQ command queue

    config SI_SG_PROG_RIG
        bool "SmartGuide Programming Rig"
        default n

    config SI_SG_I2C_SDA
        depends on SI_SG_PROG_RIG
        int "I2C SDA pin"
        range -1 64
        default 1
        help
            I2C SDA for SG current ADC

    config SI_SG_I2C_SCL
        depends on SI_SG_PROG_RIG
        int "I2C SCL pin"
        range -1 64
        default 2
        help
            I2C SCL for SG current ADC

    config SI_SG_I2C_PERIPH
        depends on SI_SG_PROG_RIG
        int "I2C Peripheral"
        range 0 1
        default 0
        help
            I2C peripheral for SG current ADC

    config SI_SG_PWR_TESTER_ALERT
        depends on SI_SG_PROG_RIG
        int "Power tester: ALERT pin"
        range -1 64
        default 4
        help
            ALERT (interrupt) pin for power tester

endmenu
```

## sdkconfig.defaults.rev5
```kconfig
# Soul Injector Rev 5 hardware defaults.
CONFIG_SI_DEVICE_BUILD="5.0"
CONFIG_SI_DISP_ENABLE=y
CONFIG_SI_DISP_PANEL_NFP114H=y
CONFIG_SI_DISP_PANEL_IO_SCLK=40
CONFIG_SI_DISP_PANEL_IO_MOSI=39
CONFIG_SI_DISP_PANEL_IO_RST=45
CONFIG_SI_DISP_PANEL_IO_DC=42
CONFIG_SI_DISP_PANEL_IO_CS=41
CONFIG_SI_DISP_PANEL_BKL=47
CONFIG_SI_DISP_PANEL_PWR=-1
CONFIG_SI_DISP_PANEL_BUFFER_SIZE=32400
CONFIG_SI_LED_SIGNAL_PIN=48
CONFIG_SI_SG_PROG_RIG=y
CONFIG_LV_USE_LOG=y
CONFIG_LV_LOG_PRINTF=y
CONFIG_LV_FONT_MONTSERRAT_10=y
CONFIG_LV_FONT_MONTSERRAT_12=y
CONFIG_LV_FONT_MONTSERRAT_16=y
CONFIG_LV_FONT_MONTSERRAT_18=y
CONFIG_LV_FONT_MONTSERRAT_20=y
CONFIG_LV_FONT_MONTSERRAT_22=y
CONFIG_LV_FONT_MONTSERRAT_24=y
CONFIG_LV_FONT_MONTSERRAT_26=y
CONFIG_LV_FONT_MONTSERRAT_28=y
CONFIG_LV_FONT_MONTSERRAT_30=y
CONFIG_LV_FONT_MONTSERRAT_32=y
CONFIG_LV_FONT_MONTSERRAT_34=y
CONFIG_LV_FONT_MONTSERRAT_36=y
CONFIG_LV_FONT_MONTSERRAT_38=y
CONFIG_LV_FONT_MONTSERRAT_40=y
CONFIG_LV_FONT_MONTSERRAT_42=y
CONFIG_LV_FONT_MONTSERRAT_44=y
CONFIG_LV_FONT_MONTSERRAT_46=y
CONFIG_LV_FONT_MONTSERRAT_48=y
CONFIG_LV_TXT_BREAK_CHARS=" ,.;:-_"
CONFIG_LV_USE_QRCODE=y
CONFIG_LV_USE_SNAPSHOT=y
CONFIG_LV_BUILD_EXAMPLES=n
CONFIG_ESP_SWD_CLK_PIN=16
CONFIG_ESP_SWD_IO_PIN=17
CONFIG_ESP_SWD_NRST_PIN=15
CONFIG_ESP_SWD_BOOT_PIN=18
```

## sdkconfig.defaults.rev6
```kconfig
# Soul Injector Rev 6 hardware defaults.
CONFIG_SI_DEVICE_BUILD="6.0"

# Rev 6 NT279VJ-C10-01-V1 display.
CONFIG_SI_DISP_ENABLE=y
CONFIG_SI_DISP_PANEL_NT279VJ=y
CONFIG_SI_DISP_PANEL_IO_SCLK=2
CONFIG_SI_DISP_PANEL_IO_MOSI=1
CONFIG_SI_DISP_PANEL_IO_RST=41
CONFIG_SI_DISP_PANEL_IO_DC=42
CONFIG_SI_DISP_PANEL_IO_CS=40
CONFIG_SI_DISP_PANEL_BKL=38
CONFIG_SI_DISP_PANEL_PWR=-1
CONFIG_SI_DISP_PANEL_BUFFER_SIZE=60776
CONFIG_SI_LED_ENABLE=n
CONFIG_SI_TARGET_DETECT_PIN=9
CONFIG_SI_SG_PROG_RIG=n

CONFIG_LV_USE_LOG=y
CONFIG_LV_LOG_PRINTF=y
CONFIG_LV_FONT_MONTSERRAT_12=y
CONFIG_LV_FONT_MONTSERRAT_16=y
CONFIG_LV_FONT_MONTSERRAT_28=y
CONFIG_LV_FONT_MONTSERRAT_32=y
CONFIG_LV_FONT_MONTSERRAT_48=y

# Rev 6 uses split SWDIO signals through SN74AXC2T245 translators.
CONFIG_ESP_SWD_PHY_AXC2T245=y
CONFIG_ESP_SWD_CLK_PIN=6
CONFIG_ESP_SWD_DATA_OUT_PIN=8
CONFIG_ESP_SWD_DATA_IN_PIN=18
CONFIG_ESP_SWD_DATA_NOE_PIN=15
CONFIG_ESP_SWD_DATA_DIR1_PIN=17
CONFIG_ESP_SWD_DATA_DIR2_PIN=16
CONFIG_ESP_SWD_CLK_NOE_PIN=4
CONFIG_ESP_SWD_NRST_PIN=7
CONFIG_ESP_SWD_BOOT_PIN=5
CONFIG_ESP_SWD_DEFAULT_CLOCK_HZ=500000
CONFIG_ESP_SWD_TURNAROUND_DELAY_US=1
CONFIG_ESP_SWD_USE_DEDICATED_GPIO=y
```

## sdkconfig.defaults.rev71
```kconfig
# Soul Injector Rev 7.1 hardware defaults.
CONFIG_SI_DEVICE_BUILD="7.1"

# Rev 7.1 NT279VJ-C10-01-V1 display.
CONFIG_SI_DISP_ENABLE=y
CONFIG_SI_DISP_PANEL_NT279VJ=y
CONFIG_SI_DISP_PANEL_IO_SCLK=53
CONFIG_SI_DISP_PANEL_IO_MOSI=54
CONFIG_SI_DISP_PANEL_IO_RST=51
CONFIG_SI_DISP_PANEL_IO_DC=52
CONFIG_SI_DISP_PANEL_IO_CS=50
CONFIG_SI_DISP_PANEL_BKL=55
CONFIG_SI_DISP_PANEL_PWR=-1
CONFIG_SI_DISP_PANEL_BUFFER_SIZE=60776
CONFIG_SI_LED_ENABLE=n
CONFIG_SI_TARGET_DETECT_PIN=3
CONFIG_SI_SG_PROG_RIG=n

CONFIG_LV_USE_LOG=y
CONFIG_LV_LOG_PRINTF=y
CONFIG_LV_FONT_MONTSERRAT_12=y
CONFIG_LV_FONT_MONTSERRAT_16=y
CONFIG_LV_FONT_MONTSERRAT_28=y
CONFIG_LV_FONT_MONTSERRAT_32=y
CONFIG_LV_FONT_MONTSERRAT_48=y

# Rev 7.1 uses split SWDIO signals through SN74AXC2T245 translators.
CONFIG_ESP_SWD_PHY_AXC2T245=y
CONFIG_ESP_SWD_CLK_PIN=10
CONFIG_ESP_SWD_DATA_OUT_PIN=16
CONFIG_ESP_SWD_DATA_IN_PIN=15
CONFIG_ESP_SWD_DATA_NOE_PIN=12
CONFIG_ESP_SWD_DATA_DIR1_PIN=14
CONFIG_ESP_SWD_DATA_DIR2_PIN=13
CONFIG_ESP_SWD_CLK_NOE_PIN=8
CONFIG_ESP_SWD_NRST_PIN=11
CONFIG_ESP_SWD_BOOT_PIN=9
CONFIG_ESP_SWD_DEFAULT_CLOCK_HZ=500000
CONFIG_ESP_SWD_TURNAROUND_DELAY_US=1
CONFIG_ESP_SWD_USE_DEDICATED_GPIO=y

# UART link to ESP-family programming targets.
CONFIG_SI_ESP32_TARGET_UART_TX_PIN=6
CONFIG_SI_ESP32_TARGET_UART_RX_PIN=7
```
