## components/qjs_binder/Kconfig
```kconfig
menu "Soul Injector job scripts"

    config SI_JS_ENABLE
        bool "Run job scripts (JS)"
        depends on SPIRAM
        default n

    config SI_JS_NETWORK
        bool "Let job scripts use WebSocket (esp:ws)"
        depends on SI_JS_ENABLE
        select QJS_ESP_MOD_WS
        default n
        help
            Only for jobs with Script.network set.

    config SI_JS_ARENA_KB
        int "Script heap (KB of PSRAM)"
        range 512 8192
        default 2048

    config SI_JS_TASK_STACK
        int "JS task stack (bytes, internal RAM)"
        range 8192 65536
        default 16384

    config SI_JS_TASK_PRIO
        int "JS task priority"
        range 1 20
        default 4

    config SI_JS_TASK_CORE
        int "JS task core"
        range 0 1
        default 0

    config SI_JS_SLICE_MS
        int "Longest one turn of a script may run (ms)"
        range 10 10000
        default 200

    config SI_JS_YIELD_MS
        int "Yield a busy script every (ms)"
        range 0 1000
        default 20

    config SI_JS_HOOK_TIMEOUT_MS
        int "Default hook timeout (ms)"
        range 100 600000
        default 30000

    config SI_JS_CALL_TIMEOUT_MS
        int "Default timeout of a sync target call (ms)"
        range 10 10000
        default 500

    config SI_JS_MAX_SCRIPT_KB
        int "Largest script (KB)"
        range 16 2048
        default 256

endmenu
```

## components/qjs_binder/test_app/sdkconfig.defaults
```kconfig
CONFIG_FREERTOS_HZ=1000
CONFIG_ESPTOOLPY_FLASHSIZE_4MB=y
CONFIG_PARTITION_TABLE_CUSTOM=y
CONFIG_PARTITION_TABLE_CUSTOM_FILENAME="partitions.csv"
CONFIG_COMPILER_OPTIMIZATION_PERF=y
CONFIG_SPIRAM=y
CONFIG_FREERTOS_WATCHPOINT_END_OF_STACK=y
CONFIG_SI_JS_ENABLE=y
CONFIG_SI_JS_CALL_TIMEOUT_MS=200
CONFIG_QJS_ESP_MOD_UDP=n
CONFIG_QJS_ESP_MOD_POSIX_SOCKET=n
CONFIG_QJS_ESP_BC_COMPILE=n
CONFIG_SI_JS_NETWORK=y
```
